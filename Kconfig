## Kconfig
```kconfig
#
# For a description of the syntax of this configuration file,
# see the file kconfig-language.txt in the NuttX tools repository.
#

config SERVICES_ATCMD
	bool "Services ATCMD"
	default n
	select NETUTILS_PING if NET_ICMP_SOCKET
	select NETUTILS_PING6 if NET_ICMPv6_SOCKET
	---help---
		Enable the ATCMD services

if SERVICES_ATCMD

config SERVICES_ATCMD_PRIORITY
	int "atcmd task priority"
	default 80
	---help---
		The priority for atcmd task.

config SERVICES_ATCMD_STACKSIZE
	int "atcmd task stack size"
	default 2048
	---help---
		The stack size allocated for the atcmd task.

config SERVICES_ATCMD_APP_PREFIX
	string "atcmd app at command prefix"
	default "+MIPL"
	---help---
		The at commands with the prefix should route to app uart

config SERVICES_ATCMD_CHIP_TEST
	bool "ATCMD Chip Test"
	default n
	select MTD
	select MTD_BYTE_WRITE
	select MTD_GD25
	select FS_LITTLEFS
	select I2C_TCA6424A
	---help---
		Enable chip test AT command.

endif # SERVICES_ATCMD
```
